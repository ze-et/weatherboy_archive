#include "Adafruit_SSD1306.h"
#include <iostream>
#include <cstdlib>

using namespace std;

static const unsigned char defFontBitmaps[] = {
    0x00, 0x00, 0x00, 0x00, 0x00, 0x3E, 0x5B, 0x4F, 0x5B, 0x3E, 0x3E, 0x6B,
    0x4F, 0x6B, 0x3E, 0x1C, 0x3E, 0x7C, 0x3E, 0x1C, 0x18, 0x3C, 0x7E, 0x3C,
    0x18, 0x1C, 0x57, 0x7D, 0x57, 0x1C, 0x1C, 0x5E, 0x7F, 0x5E, 0x1C, 0x00,
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    0x14, 0x08, 0x55, 0x00, 0x55, 0x00, 0x55, // #176 (25% block) missing in old
    // code
    0xAA, 0x55, 0xAA, 0x55, 0xAA,             // 50% block
    0xFF, 0x55, 0xFF, 0x55, 0xFF,             // 75% block
    0x00, 0x00, 0x00, 0xFF, 0x00, 0x10, 0x10, 0x10, 0xFF, 0x00, 0x14, 0x14,
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    0x3C, 0x00, 0x00, 0x00, 0x00, 0x00 // #255 NBSP
};

const GFXglyph defFontGlyphs[] = {
    {0, 8, 5, 5, 0, -1},
    {5, 8, 5, 5, 0, -1},
    {10, 8, 5, 5, 0, -1},
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    {1275, 8, 5, 5, 0, -1},
};

const GFXfont defFont = {
    (uint8_t  *)defFontBitmaps,
    (GFXglyph *)defFontGlyphs,
    0x00, 0xFF, 8};

bool Adafruit_SSD1306::begin(uint8_t switchvcc, uint8_t i2caddr,
           bool reset, bool periphBegin)
{
	font_color = WHITE;
  setFont(nullptr);
  is_inverted = 0;
  cursor_x = 0;
  cursor_y = 0;
  clearDisplay();
  return true;
}
void Adafruit_SSD1306::display(void)
{
  for(int y = 0; y < 64; y += 1){
    for(int x = 0; x < 16; x +=1){
      for(int x_bit = 7; x_bit >= 0; x_bit -= 1){
        if((pixel[x][y] & (1 << x_bit)) ^ is_inverted){
          cout << '#';
        }
        else{
          cout << '.';
        }
      }
    }
    cout <<  '\n';
  }
  cout << "\n\n\n\n";
}
void Adafruit_SSD1306::clearDisplay(void)
{
  for(int x = 0; x < 16; x +=1){
    for(int y = 0; y < 64; y += 1){
      pixel[x][y] = 0;
     }
   }
}
void Adafruit_SSD1306::invertDisplay(bool i)
{
  is_inverted = i;
}
void Adafruit_SSD1306::drawPixel(int16_t x, int16_t y, uint16_t color)
{
  x = x % 128;
  y = y % 64;
  switch(color){
    case BLACK:
      pixel[x >> 3][y] &= ~(0x80 >> (x & 7));
      break;
    case WHITE:
      pixel[x >> 3][y] |= (0x80 >> (x & 7));
      break;
    case INVERSE:
      pixel[x >> 3][y] ^= (0x80 >> (x & 7));
      break;
  }
}
void Adafruit_SSD1306::drawFastHLine(int16_t x, int16_t y, int16_t w, uint16_t color)
{
  for(int i = 0; i < w; i += 1){
    drawPixel(x + i, y, color);
  }
}
void Adafruit_SSD1306::drawFastVLine(int16_t x, int16_t y, int16_t h, uint16_t color)
{
  for(int i = 0; i < h; i += 1){
    drawPixel(x, y + i, color);
  }
}
bool Adafruit_SSD1306::getPixel(int16_t x, int16_t y)
{
  return pixel[x >> 3][y] & (0x80 >> (x & 7));
}

void Adafruit_SSD1306::setCursor(uint8_t x, uint8_t y)
{
  cursor_x = x;
  cursor_y = y;
}
void Adafruit_SSD1306::setTextColor(uint8_t color)
{
  font_color = color;
}
void Adafruit_SSD1306::setTextSize(uint8_t size)
{
  font_size = size;
}

void Adafruit_SSD1306::fillRect(int16_t x, int16_t y, int16_t w, int16_t h,
              uint16_t color)
{
  for(int i = 0; i < h; i += 1){
    drawFastHLine(x, y + i, w, color);
  }
}

void Adafruit_SSD1306::fillRoundRect(int16_t x, int16_t y, int16_t w, int16_t h,
                                     int16_t radius, uint16_t color)
{
  int16_t max_radius = ((w < h) ? w : h) >> 1;
  if(radius > max_radius){
    radius = max_radius;
  }
  for(int i = radius; i < h - radius; i += 1){
    drawFastHLine(x, y + i, w, color);
  }
  const int small_isqrt[] = {0,
                               1, 1, 1,
                               2, 2, 2, 2, 2,
                               3, 3, 3, 3, 3, 3, 3,
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                               8, 8, 8, 8, 8, 8, 8, 8, 8, 8, 8, 8, 8, 8, 8, 8, 8,
                               9};
  for(int i = 0; i < radius; i += 1){
    int gap = radius - small_isqrt[radius*radius - (radius-i)*(radius-i)];
    drawFastHLine(x + gap, y + i,          w - gap * 2, color);
    drawFastHLine(x + gap, y + h - i - 1, w - gap * 2, color);
  }
}

/// Draw Line is taken straight from the GFX library; I realised pretty soon it
/// would require a high effort solution, so I checked if the library has an
/// easy to implement solve, and lo and behold, it does
#ifndef _swap_int16_t
#define _swap_int16_t(a, b)                                                  \
{                                                                            \
  int16_t t = a;                                                             \
  a = b;                                                                     \
  b = t;                                                                     \
}
#endif
void Adafruit_SSD1306::drawLine(int16_t x0, int16_t y0, int16_t x1, int16_t y1,
                                uint16_t color)
{

  #if defined(ESP8266)
  yield();
  #endif
  int16_t steep = abs(y1 - y0) > abs(x1 - x0);
  if (steep) {
    _swap_int16_t(x0, y0);
    _swap_int16_t(x1, y1);
  }

  if (x0 > x1) {
    _swap_int16_t(x0, x1);
    _swap_int16_t(y0, y1);
  }

  int16_t dx, dy;
  dx = x1 - x0;
  dy = abs(y1 - y0);

  int16_t err = dx / 2;
  int16_t ystep;

  if (y0 < y1) {
    ystep = 1;
  } else {
    ystep = -1;
  }

  for (; x0 <= x1; x0++) {
    if (steep) {
      drawPixel(y0, x0, color);
    } else {
      drawPixel(x0, y0, color);
    }
    err -= dy;
    if (err < 0) {
      y0 += ystep;
      err += dx;
    }
  }
}
void Adafruit_SSD1306::setFont(const GFXfont *f)
{
  if(f){
   font = f;
  }
  else{
    font = &defFont;
  }
}
void Adafruit_SSD1306::print(char character)
{
  int16_t c_idx = character - font->first;
  if(c_idx < 0){
    return;
  }
  if(character > font->last){
    return;
  }
  auto const& glyph = font->glyph[c_idx];
  uint16_t b_idx = glyph.bitmapOffset;
  uint8_t* bitmap = &(font->bitmap[b_idx]);
  uint8_t x = cursor_x + glyph.xOffset;
  uint8_t y = cursor_y + glyph.yOffset;
  bool const is_font_legacy = glyph.width == 8 || glyph.height == 5;

  for(int y_i = 0; y_i < font_size; y_i += 1){
    for(int x_i = 0; x_i < font_size; x_i += 1){
      if(is_font_legacy){
        drawBitmap(x + x_i,     y - y_i, bitmap,
                   glyph.width, glyph.height, font_color, font_size, true);
      }
      else{
        drawBitmap(x + x_i,     y + y_i + 4, bitmap,
                   glyph.width, glyph.height, font_color, font_size, true);
      }
    }
  }
  if(is_font_legacy){
    cursor_x += 6 * font_size;
  }
  else{
    cursor_x += (glyph.xAdvance) * font_size;
  }
}

void Adafruit_SSD1306::print(int number)
{
  print(to_string(number));
}
void Adafruit_SSD1306::print(unsigned int number)
{
  print(to_string(number));
}

void Adafruit_SSD1306::print(std::string text)
{
  for(int i = 0; i < text.length(); i += 1){
    print(text[i]);
  }
}

void Adafruit_SSD1306::println(char character)
{
  int old_cursor_x = cursor_x;
  print(character);
  cursor_y += font->yAdvance;
  cursor_x = old_cursor_x;
}

void Adafruit_SSD1306::println(std::string text)
{
  int old_cursor_x = cursor_x;
  print(text);
  cursor_y += font->yAdvance;
  cursor_x = old_cursor_x;
}

void Adafruit_SSD1306::drawBitmap(int16_t x, int16_t y, const uint8_t bitmap[], int16_t w, int16_t h,
                                  uint16_t color, int strife, bool do_not_round)
{
  int i = 0;
  int16_t w_byte;
  if(do_not_round){
    w_byte = w;
  }
  else{
    w_byte = w & 7 ? (w + 8) & ~7 : w;
  }

  for(int y_i = 0; y_i < h; y_i += 1){
    for(int x_i = 0; x_i < w_byte; x_i += 1){
      if(bitmap[i>>3] & (0x80 >> (i & 7))){
        if(w == 8 && h == 5){
          drawPixel(x + y_i * strife, y + (w - x_i) * strife, color);
        }
        else{
          drawPixel(x + x_i * strife, y + y_i * strife, color);
        }
      }
      i += 1;
    }
  }
}
